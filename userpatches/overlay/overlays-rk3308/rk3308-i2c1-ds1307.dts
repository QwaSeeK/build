/dts-v1/;
/plugin/;

/ {
	compatible = "rockchip,rk3308";

	fragment@0 {
		target = <&i2c1>;
		__overlay__ {
			status = "okay";
			ds1307@68 {
				compatible = "dallas,ds1307";
				reg = <0x68>;
				status = "okay";
			};
		};
	};
};
