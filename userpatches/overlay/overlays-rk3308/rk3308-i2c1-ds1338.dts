/dts-v1/;
/plugin/;

/ {
	compatible = "rockchip,rk3308";

	fragment@0 {
		target = <&i2c1>;
		__overlay__ {
			status = "okay";
			ds1338@68 {
				compatible = "dallas,ds1338";
				reg = <0x68>;
				status = "okay";
			};
		};
	};
};
