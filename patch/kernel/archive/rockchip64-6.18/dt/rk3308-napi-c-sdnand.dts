// SPDX-License-Identifier: (GPL-2.0+ OR MIT)
/*
 * Copyright (c) 2026 Nikita Maslo <nikitamalco203@gmail.com>
 */

/dts-v1/;

#include "rk3308-napi-c.dtsi"

/ {
	model = "NAPI-C (SD NAND)";
};

/*
 * Board revision with an SD NAND (ZDSD02GLGEAG) on the eMMC pins. Only SD0..SD3
 * are wired, so emmc_bus4 (GPIO3 PA0-PA3) is used instead of emmc_bus8 and
 * GPIO3 PA4-PA7 stay free. VDD comes from VCC_IO, so everything is 3.3 V and
 * there is no HS200 - cap-sd-highspeed is what lifts it off the 25 MHz default.
 */
&emmc {
	bus-width = <4>;
	cap-mmc-highspeed;
	cap-sd-highspeed;
	no-sdio;
	non-removable;
	max-frequency = <200000000>;
	pinctrl-names = "default";
	pinctrl-0 = <&emmc_bus4 &emmc_clk &emmc_cmd>;
	vmmc-supply = <&vcc_io>;
	vqmmc-supply = <&vcc_io>;
	status = "okay";
};

&io_domains {
	vccio3-supply = <&vcc_io>;
};
