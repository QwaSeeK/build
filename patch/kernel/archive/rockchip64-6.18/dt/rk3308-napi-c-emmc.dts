// SPDX-License-Identifier: (GPL-2.0+ OR MIT)
/*
 * Copyright (c) 2026 Nikita Maslo <nikitamalco203@gmail.com>
 */

/dts-v1/;

#include "rk3308-napi-c.dtsi"

/ {
	model = "NAPI-C (eMMC)";
};

&emmc {
	bus-width = <8>;
	cap-mmc-highspeed;
	cap-sd-highspeed;
	mmc-hs200-1_8v;
	no-sdio;
	non-removable;
	max-frequency = <200000000>;
	pinctrl-names = "default";
	pinctrl-0 = <&emmc_bus8 &emmc_clk &emmc_cmd>;
	vmmc-supply = <&vcc_io>;
	vqmmc-supply = <&vcc_1v8>;
	status = "okay";
};

&io_domains {
	vccio3-supply = <&vcc_1v8>;
};
