/dts-v1/;
/plugin/;

/ {
	compatible = "rockchip,rk3308";

	fragment@0 {
		target = <&spi2>;
		__overlay__ {
			#address-cells = <1>;
			#size-cells = <0>;
			status = "okay";
			spidev@0 {
				compatible = "rohm,dh2228fv";
				status = "okay";
				reg = <0>;
				spi-max-frequency = <10000000>;
			};
		};
	};
};
