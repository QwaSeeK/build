/dts-v1/;
/plugin/;

/ {
	compatible = "rockchip,rk3308";

	fragment@0 {
		target = <&spi2>;
		__overlay__ {
			status = "disabled";
		};
	};

	fragment@1 {
		target = <&uart1>;
		__overlay__ {
			status = "disabled";
		};
	};

	fragment@2 {
		target = <&i2c0>;
		__overlay__ {
			status = "okay";
		};
	};
};
