/dts-v1/;
/plugin/;

/ {
    compatible = "rockchip,rk3308";

    fragment@0 {
        target = <&i2c1>;

        overlay {
            status = "okay";

            eeprom@50 {
                compatible = "atmel,24c02";
                reg = <0x50>;
                status = "okay";
            };
        };
    };
};
