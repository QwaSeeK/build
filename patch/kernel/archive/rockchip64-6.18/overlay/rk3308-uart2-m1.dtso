/dts-v1/;
/plugin/;

/ {
	compatible = "rockchip,rk3308";

	fragment@0 {
		target = <&spi2>;
		__overlay__ {
			status = "disabled";
		};
	};

	fragment@1 {
		target = <&uart2>;
		__overlay__ {
			pinctrl-0 = <&uart2m1_xfer>;
			status = "okay";
		};
	};
};
